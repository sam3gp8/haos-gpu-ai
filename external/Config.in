## external/Config.in
```kconfig
menu "HAOS GPU/AI unified compute stack"

config BR2_PACKAGE_HAOS_GPU_AI_ALL
	bool "Enable unified tri-vendor GPU/AI compute stack"
	default y
	depends on BR2_x86_64
	select BR2_PACKAGE_HAOS_COMPUTE_NVIDIA
	select BR2_PACKAGE_HAOS_COMPUTE_INTEL
	select BR2_PACKAGE_HAOS_COMPUTE_AMD
	help
	  Master switch for this external tree. When enabled (the default),
	  all three vendor compute stacks are force-selected so that a single,
	  hardware-agnostic image is produced.

	  Only ONE stack is activated at runtime: gpu-autodetect inspects the
	  PCI bus at boot and loads the modules for whichever vendor is actually
	  present, then configures the Docker default runtime accordingly.

	  Turn this off only if you want to hand-pick a subset of vendors below.

if BR2_PACKAGE_HAOS_GPU_AI_ALL
comment "NVIDIA + Intel + AMD stacks are force-enabled by BR2_PACKAGE_HAOS_GPU_AI_ALL"
endif

source "$BR2_EXTERNAL_HAOS_GPU_AI_PATH/package/haos-compute-nvidia/Config.in"
source "$BR2_EXTERNAL_HAOS_GPU_AI_PATH/package/haos-nvidia-container-toolkit/Config.in"
source "$BR2_EXTERNAL_HAOS_GPU_AI_PATH/package/haos-compute-intel/Config.in"
source "$BR2_EXTERNAL_HAOS_GPU_AI_PATH/package/haos-compute-amd/Config.in"

endmenu
```

## external/package/haos-compute-amd/Config.in
```kconfig
config BR2_PACKAGE_HAOS_COMPUTE_AMD
	bool "AMD GPU compute host contract (amdgpu + KFD + firmware + dri/kfd nodes)"
	default y if BR2_PACKAGE_HAOS_GPU_AI_ALL
	depends on BR2_x86_64
	select BR2_PACKAGE_LINUX_FIRMWARE
	help
	  Establishes the HOST side of AMD GPU compute:

	    * amdgpu kernel driver         (enabled via the kernel fragment)
	    * KFD compute interface        (CONFIG_HSA_AMD -> /dev/kfd)
	    * Radeon/Instinct firmware     (from linux-firmware, amdgpu/*)
	    * /dev/dri/* + /dev/kfd nodes  (udev overlay)

	  It deliberately does NOT compile the ROCm/HIP user-space stack (rocBLAS,
	  hipBLAS, the HIP runtime, ROCr) into the base OS. ROCm is enormous and
	  does not build in Buildroot; more importantly it belongs in the add-on
	  container. Ollama's ROCm image (and vLLM's ROCm image) bundle the whole
	  runtime and talk to the kernel through the /dev/kfd + /dev/dri nodes this
	  contract guarantees. See NOTES.md.
```

## external/package/haos-compute-intel/Config.in
```kconfig
config BR2_PACKAGE_HAOS_COMPUTE_INTEL
	bool "Intel GPU/XPU compute host contract (i915/xe + firmware + dri nodes)"
	default y if BR2_PACKAGE_HAOS_GPU_AI_ALL
	depends on BR2_x86_64
	select BR2_PACKAGE_LINUX_FIRMWARE
	help
	  Establishes the HOST side of Intel GPU compute:

	    * i915 / xe kernel drivers   (enabled via the kernel fragment)
	    * Intel GuC/HuC + DMC firmware (from linux-firmware)
	    * /dev/dri/renderD* nodes with the correct permissions (udev overlay)

	  It deliberately does NOT compile intel-compute-runtime (NEO), the Intel
	  Graphics Compiler (IGC), gmmlib, or level-zero into the base OS. That
	  stack (a) is impractical to cross-compile in Buildroot - IGC alone drags
	  in LLVM/Clang/SPIRV - and (b) does not belong in an immutable appliance
	  rootfs. The Level-Zero / oneAPI / NEO runtime ships in the add-on
	  container (Intel publishes oneAPI base images), talking to the kernel
	  driver through the /dev/dri render node this contract guarantees.

	  See NOTES.md in this package directory for the container-side recipe.
```

## external/package/haos-nvidia-container-toolkit/Config.in
```kconfig
config BR2_PACKAGE_HAOS_NVIDIA_CONTAINER_TOOLKIT
	bool "NVIDIA Container Toolkit (runtime hook for GPU add-ons)"
	default y if BR2_PACKAGE_HAOS_COMPUTE_NVIDIA
	depends on BR2_x86_64
	help
	  Installs the NVIDIA Container Toolkit host components:

	    nvidia-container-runtime      - OCI runtime shim referenced by daemon.json
	    nvidia-container-runtime-hook - prestart hook that injects driver libs
	    nvidia-container-cli          - libnvidia-container front-end
	    nvidia-ctk                    - config/CDI generator
	    libnvidia-container.so        - device + library injection library

	  This is what lets an Ollama / vLLM add-on container see the host GPU at
	  bare-metal speed without bundling the driver: the hook bind-mounts the
	  host driver libraries and /dev nodes into the container namespace.

if BR2_PACKAGE_HAOS_NVIDIA_CONTAINER_TOOLKIT

config BR2_PACKAGE_HAOS_NVIDIA_CONTAINER_TOOLKIT_VERSION
	string "NVIDIA Container Toolkit version"
	default "1.19.1"
	help
	  Release version pulled from github.com/NVIDIA/nvidia-container-toolkit.
	  Confirm the asset name for the version you pin (see the .mk); NVIDIA has
	  changed release artifact layout between minor versions.

endif
```
